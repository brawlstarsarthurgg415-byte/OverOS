## buildroot/overos_x86_64_defconfig
```kconfig
BR2_x86_64=y
BR2_TOOLCHAIN_BUILDROOT_MUSL=y
BR2_USE_WCHAR=y
BR2_INSTALL_LIBSTDCPP=y
BR2_INIT_BUSYBOX=y
BR2_SYSTEM_DHCP="eth0"
BR2_TARGET_GENERIC_HOSTNAME="overos"
BR2_TARGET_GENERIC_ISSUE="OverOS Custom"
BR2_TARGET_GENERIC_GETTY=y
BR2_TARGET_GENERIC_GETTY_PORT="tty1"
BR2_TARGET_GENERIC_GETTY_BAUDRATE_115200=y
BR2_PACKAGE_BUSYBOX=y
BR2_PACKAGE_OPENSSH=y
BR2_PACKAGE_CA_CERTIFICATES=y

# Runtime support for the low-memory desktop and network setup.
BR2_ROOTFS_DEVICE_CREATION_DYNAMIC_EUDEV=y
BR2_PACKAGE_EUDEV=y
BR2_PACKAGE_NETWORK_MANAGER=y
BR2_PACKAGE_NETWORK_MANAGER_TUI=y
BR2_PACKAGE_NETWORK_MANAGER_CLI=y
BR2_PACKAGE_WPA_SUPPLICANT=y
BR2_PACKAGE_OPENSSH_SERVER=y
BR2_PACKAGE_LINUX_FIRMWARE=y
BR2_PACKAGE_LINUX_FIRMWARE_BRCM_BCM43XX=y
BR2_PACKAGE_XSERVER_XORG_SERVER=y
BR2_PACKAGE_XSERVER_XORG_SERVER_KDRIVE=y
BR2_PACKAGE_OPENBOX=y
BR2_PACKAGE_XAPP_XINIT=y
BR2_PACKAGE_XTERM=y
BR2_PACKAGE_TAR=y
BR2_LINUX_KERNEL=y
BR2_LINUX_KERNEL_LATEST_VERSION=y
BR2_LINUX_KERNEL_USE_DEFCONFIG=y
BR2_LINUX_KERNEL_DEFCONFIG="x86_64"
BR2_LINUX_KERNEL_INSTALL_TARGET=y
BR2_LINUX_KERNEL_CONFIG_FRAGMENT_FILES="board/overos/linux.fragment"
BR2_TARGET_ROOTFS_TAR=y
BR2_TARGET_ROOTFS_EXT2=y
BR2_TARGET_ROOTFS_EXT2_4=y
BR2_TARGET_ROOTFS_EXT2_SIZE="900M"
BR2_ROOTFS_OVERLAY="board/overos-rootfs-overlay"
BR2_TARGET_GENERIC_REMOUNT_ROOTFS_RW=y
```
